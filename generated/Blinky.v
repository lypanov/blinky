// Generated by CIRCT firtool-1.62.1
// Standard header to adapt well known macros for prints and assertions.

// Users can define 'PRINTF_COND' to add an extra gate to prints.
`ifndef PRINTF_COND_
  `ifdef PRINTF_COND
    `define PRINTF_COND_ (`PRINTF_COND)
  `else  // PRINTF_COND
    `define PRINTF_COND_ 1
  `endif // PRINTF_COND
`endif // not def PRINTF_COND_

module Blinky(
  input  clock,
         reset,
  output io_led,
  input  io_speed_up_n
);

  wire [2:0]  currentFreq = io_speed_up_n ? 3'h1 : 3'h2;
  reg  [31:0] counter;
  reg         ledState;
  wire        _GEN = counter >= {7'h0, 25'h19BFCC0 / {21'h0, currentFreq, 1'h0}};
  `ifndef SYNTHESIS
    always @(posedge clock) begin
      if ((`PRINTF_COND_) & _GEN & ~reset)
        $fwrite(32'h80000002, "LED toggled to %d at frequency %d Hz\n", ledState,
                currentFreq);
      if ((`PRINTF_COND_) & counter == 32'h0 & ~reset)
        $fwrite(32'h80000002, "Counter reset, current blink frequency: %d Hz\n",
                currentFreq);
    end // always @(posedge)
  `endif // not def SYNTHESIS
  always @(posedge clock) begin
    if (reset) begin
      counter <= 32'h0;
      ledState <= 1'h0;
    end
    else begin
      if (_GEN)
        counter <= 32'h0;
      else
        counter <= counter + 32'h1;
      ledState <= _GEN ^ ledState;
    end
  end // always @(posedge)
  assign io_led = ledState;
endmodule

